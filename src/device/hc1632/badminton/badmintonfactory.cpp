#include "badmintonfactory.h"
#include "raspigpiofactory.h"
#include "raspigpio.h"
#include "raspipia.h"
#include "gpioexception.h"
#include "log.h"
#include "hc1632.h"

#include <sstream>
#include <vector>
#include <thread>
#include <cmath>

/* 01/02/04/08/10/20/40/80 */
uint8_t chiffre[10][48] ={
  { 0x00, 0x00, 0x00, 0x00, 0xFC, 0x3F, 0xFC, 0x3F, 0xFC, 0x3F, 0xFC, 0x3F, 0x3C,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 0x00, 0x00 }
, { 0x00, 0x00, 0x00, 0x00, 0x00, 0x3C, 0x00, 0x3C, 0x00, 0x3C, 0x00, 0x3C, 0x00,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 0x00, 0x00 }
, { 0x00, 0x00, 0x00, 0x00, 0xFC, 0x3F, 0xFC, 0x3F, 0xFC, 0x3F, 0xFC, 0x3F, 0x00,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 0x00, 0x00 }
, { 0x00, 0x00, 0x00, 0x00, 0xFC, 0x3F, 0xFC, 0x3F, 0xFC, 0x3F, 0xFC, 0x3F, 0x00,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 0x00, 0x00 }
, { 0x00, 0x00, 0x00, 0x00, 0x3C, 0x3C, 0x3C, 0x3C, 0x3C, 0x3C, 0x3C, 0x3C, 0x3C,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 0x00, 0x00 }
, { 0x00, 0x00, 0x00, 0x00, 0xFC, 0x3F, 0xFC, 0x3F, 0xFC, 0x3F, 0xFC, 0x3F, 0x3C,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 0x00, 0x00 }
, { 0x00, 0x00, 0x00, 0x00, 0xFC, 0x3F, 0xFC, 0x3F, 0xFC, 0x3F, 0xFC, 0x3F, 0x3C,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 0x00, 0x00 }
, { 0x00, 0x00, 0x00, 0x00, 0xFC, 0x3F, 0xFC, 0x3F, 0xFC, 0x3F, 0xFC, 0x3F, 0x00,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 0x00, 0x00 }
, { 0x00, 0x00, 0x00, 0x00, 0xFC, 0x3F, 0xFC, 0x3F, 0xFC, 0x3F, 0xFC, 0x3F, 0x3C,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 0x00, 0x00 }
, { 0x00, 0x00, 0x00, 0x00, 0xFC, 0x3F, 0xFC, 0x3F, 0xFC, 0x3F, 0xFC, 0x3F, 0x3C,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 0x00, 0x00 }
};
uint8_t tiret[48] = { 0x00, 0x00, 0x00, 0x00, 0x00, 0x00, 0x00, 0x00, 0x00, 0x00, 0x00, 0x00, 0x00,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 0x00, 0x00 };
uint8_t terrain[5][48] = {
  { 0xFF, 0xFF, 0x09, 0x00, 0x09, 0x00, 0xFF, 0xFF, 0x09, 0x00, 0x09, 0x00, 0x09,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 0xFF, 0xFF }
, { 0xFF, 0xFF, 0x00, 0x80, 0x00, 0x80, 0xFF, 0xFF, 0x00, 0x80, 0x00, 0x80, 0x00,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 0xFF, 0xFF }
, { 0xFF, 0xFF, 0x80, 0x01, 0x80, 0x01, 0xFF, 0xFF, 0x80, 0x01, 0x80, 0x01, 0x80,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 0xFF, 0xFF }
, { 0xFF, 0xFF, 0x01, 0x00, 0x01, 0x00, 0xFF, 0xFF, 0x01, 0x00, 0x01, 0x00, 0x01,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 0xFF, 0xFF }
, { 0xFF, 0xFF, 0x00, 0x90, 0x00, 0x90, 0xFF, 0xFF, 0x00, 0x90, 0x00, 0x90, 0x00,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 0xFF, 0xFF }
};

const int32_t NB_POINT = 48;
int32_t score_droit = 0;
int32_t score_gauche = 0;

BatmintonFactory::BatmintonFactory()
: Pollactory()
, _status(0)
{
// GPIOHANDLE_REQUEST_INPUT
// GPIOHANDLE_REQUEST_OUTPUT
// GPIOHANDLE_REQUEST_ACTIVE_LOW
// GPIOHANDLE_REQUEST_OPEN_DRAIN
// GPIOHANDLE_REQUEST_OPEN_SOURCE
	RaspiGpioFactory gpio_fact("/dev/gpiochip0");
	RaspiGpio * _bt_raz = gpio_fact.event(RAZ_PIN,GPIOEVENT_REQUEST_FALLING_EDGE);
	RaspiGpio * _bt_droite = gpio_fact.event(DROITE_PIN, GPIOEVENT_REQUEST_FALLING_EDGE);
	RaspiGpio * _bt_gauche = gpio_fact.event(GAUCHE_PIN, GPIOEVENT_REQUEST_FALLING_EDGE);
	RaspiGpio * _bt_fin = gpio_fact.event(FIN_PIN, GPIOEVENT_REQUEST_FALLING_EDGE);
	add(_bt_raz);
	add(_bt_droite);
	add(_bt_gauche);
	add(_bt_fin);

	RaspiGpio * _data = gpio_fact.output(&DATA_PIN, 1);
	RaspiPIA pia_data(_data);
	RaspiGpio * _write = gpio_fact.output(&WRITE_PIN, 1);
	RaspiPIA pia_write(_write);
	for (int32_t i=0; i<NB_MATRIX; ++i)
	{
		RaspiGpio * cs = gpio_fact.output(&CS_PIN[i], 1);
		RaspiPIA pia_cs(_cs);
		_matrix.push_back(new HC1632(pia_data, pia_write, pia_cs, ((i==0) ? 2 : 0)));
	}


	_matrix[0]->write_led_buffer(chiffre[score_gauche/10], NB_POINT);
//	_matrix[2]->write_led_buffer(chiffre[score_gauche%10], NB_POINT);
//	_matrix[4]->write_led_buffer(tiret, NB_POINT);
//	_matrix[6]->write_led_buffer(chiffre[score_droit/10], NB_POINT);
//	_matrix[8]->write_led_buffer(chiffre[score_droit%10], NB_POINT);

//	_matrix[1]->write_led_buffer(terrain[0], NB_POINT);
//	_matrix[3]->write_led_buffer(terrain[1], NB_POINT);
//	_matrix[5]->write_led_buffer(terrain[2], NB_POINT);
//	_matrix[7]->write_led_buffer(terrain[3], NB_POINT);
//	_matrix[9]->write_led_buffer(terrain[4], NB_POINT);

	_last_valid_irq = std::chrono::high_resolution_clock::now();

}

BatmintonFactory::~BatmintonFactory()
{
	delete _matrix;
}

int32_t BatmintonFactory::actionIn(PollDevice * device)
{
	Log::getLogger()->debug(__FILE__, __LINE__, "actionIn");

	Gpio * bt = (Gpio *)device;

	std::chrono::time_point<std::chrono::high_resolution_clock> new_irq = std::chrono::high_resolution_clock::now();
	std::chrono::duration<double> elapsed = new_irq - _last_valid_irq;
	Log::getLogger()->debug(__FILE__, __LINE__, std::to_string(elapsed.count()));
	if (fabs(elapsed.count()) > 1.)
	{
		_last_valid_irq = new_irq;
		switch(bt->pinNumber())
		{
			case FIN_PIN:
				Log::getLogger()->debug(__FILE__, __LINE__, "FIN");
				score_droit = 0;
				score_gauche = 0;
				break;

			case RAZ_PIN:
				Log::getLogger()->debug(__FILE__, __LINE__, "RAZ");
				score_droit = 0;
				score_gauche = 0;
				break;

			case DROITE_PIN:
				Log::getLogger()->debug(__FILE__, __LINE__, "DROITE_PIN");
				score_droit += 1;
				if (score_droit > 99)
				{
					score_droit = 0;
				}
				break;

			case GAUCHE_PIN:
				Log::getLogger()->debug(__FILE__, __LINE__, "GAUCHE_PIN");
				score_gauche += 1;
				if (score_gauche > 99)
				{
					score_gauche = 0;
				}
				break;
				
			default:
				std::stringstream ss;
				ss << "PIN " << bt->pinNumber() << " inconnue !!!";
				Log::getLogger()->debug(__FILE__, __LINE__, ss.str());
				break;
		}

		_status = bt->pinNumber();
		return bt->pinNumber();
	}

	return 0;
}

int32_t BatmintonFactory::status()
{
	return _status;
}

void BatmintonFactory::majAffichage()
{
	_matrix[0]->write_led_buffer(chiffre[score_gauche/10], NB_POINT);
//	_matrix[2]->write_led_buffer(chiffre[score_gauche%10], NB_POINT);
//	_matrix[6]->write_led_buffer(chiffre[score_droit/10], NB_POINT);
//	_matrix[8]->write_led_buffer(chiffre[score_droit%10], NB_POINT);
	_status = 0;
}
