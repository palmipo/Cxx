
#ifndef F_CPU
#define F_CPU 8000000UL
#endif

#include <avr/io.h>
#include <avr/interrupt.h>
#include <string.h>
#include <util/delay.h>
#include <stdlib.h>

// Generated by delay loop calculator
// at http://www.bretmulvey.com/avrdelay.html
// Delay 1 cycles
// 125 ns at 8.0 MHz

#define NB_BIT		8
#define NB_CANAUX	3


void affiche(uint8_t *pixels)
{
	volatile uint8_t *ptr = pixels;
	volatile uint8_t b = *ptr++;

	cli();

	asm volatile (

	"        ldi  r19, 0xFF"		"\n\t"
	"        ldi  r20, 0"			"\n\t"

	// break 88µs
	"		out %[port], r20"		"\n\t"
	"		ldi  r18, 254"			"\n\t"
	"1:		dec  r18"				"\n\t"
	"		brne 1b"				"\n\t"

	// post break 8µs
	"       out %[port], r19"		"\n\t"
	"		ldi  r18, 32"			"\n\t"
	"2:		dec  r18"				"\n\t"
	"		brne 2b"				"\n\t"

	"		ldi  r17, %[nb_canaux]"	"\n\t"
	//start 4µs
	"octet:	out %[port], r20"		"\n\t"
	"		ldi  r18, 10"			"\n\t"
	"3:		dec  r18"				"\n\t"
	"		brne 3b"				"\n\t"

	// bits 4µs
	"		ldi  r16, %[nb_bit]"	"\n\t"
	"loop:	out %[port], %[byte]"	"\n\t"
	"		ldi  r18, 8"			"\n\t"
	"4:		dec  r18"				"\n\t"
	"		brne 4b"				"\n\t"
    "		ld   %[byte] , %a[ptr]+""\n\t"
    "       dec  r16"				"\n\t"
    "       brne loop"				"\n\t"

	//stop 8µs
	"       out %[port], r19"		"\n\t"
	"		ldi  r18, 20"			"\n\t"
	"5:		dec  r18"				"\n\t"
	"		brne 5b"				"\n\t"

	//"       out %[port], r19"		"\n\t"
	//"		ldi  r18, 32"			"\n\t"
	//"6:		dec  r18"				"\n\t"
	//"		brne 6b"				"\n\t"

    "       dec  r17"				"\n\t"
    "       brne octet"				"\n\t"
	: [byte] "+r" (b)
	: [port] "I" (_SFR_IO_ADDR(PORTA))
	, [ptr] "e" (ptr)
	, [nb_canaux] "M" (NB_CANAUX)
	, [nb_bit] "M" (NB_BIT)
	);
	
	sei();
}

void setPixel(uint8_t voie, uint8_t canal, uint8_t valeur, uint8_t *pixels)
{
	if ((voie >= 0) && (voie < 8) && (canal > 0) && (canal < NB_CANAUX))
	{
		int8_t i;
		for (i=0; i<NB_BIT; ++i)
		{
			pixels[(NB_BIT * canal) + i] = ((valeur >> i) & 0x01) << voie;
		}
	}
}

int main(void)
{
	DDRA = 0xFF;
	PORTA = 0xFF;
	
	uint8_t pixels[NB_BIT * NB_CANAUX];
	
	memset(pixels, 0, NB_BIT * NB_CANAUX);

	uint8_t valeur;
	while(1)
	{
		valeur = rand() % 0xFF;
		setPixel(0, 1, valeur, pixels);
		valeur = rand() % 0xFF;
		setPixel(0, 2, valeur, pixels);
		valeur = rand() % 0xFF;
		setPixel(0, 3, valeur, pixels);
		affiche(pixels);
		_delay_ms(100);
	}
}
